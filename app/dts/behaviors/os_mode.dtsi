/*
 * Copyright (c) 2022 The ZMK Contributors
 *
 * SPDX-License-Identifier: MIT
 */

/ {
	behaviors {
		/omit-if-no-ref/ os: behavior_os_mode {
			compatible = "zmk,behavior-os-mode";
			label = "OS_MODE";
			#binding-cells = <2>;
		};
	};
};
