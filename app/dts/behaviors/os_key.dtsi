/*
 * Copyright (c) 2022 The ZMK Contributors
 *
 * SPDX-License-Identifier: MIT
 */

 / {
	behaviors {
		/omit-if-no-ref/ osk: osk {
			compatible = "zmk,behavior-os-key";
			label = "OS_KEY";
			#binding-cells = <2>;
			bindings = <&kp>, <&kp>;
		};
	};
};
