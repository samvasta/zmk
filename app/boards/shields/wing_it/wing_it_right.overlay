/*
 * Copyright (c) 2020 The ZMK Contributors
 *
 * SPDX-License-Identifier: MIT
 */

#include "wing_it.dtsi"

&default_transform {
	col-offset = <7>;
};

&kscan0 {
		col-gpios
			= <&pro_micro 16 (GPIO_ACTIVE_HIGH | GPIO_PULL_DOWN)>	// Schematic Col 6
			, <&pro_micro 14 (GPIO_ACTIVE_HIGH | GPIO_PULL_DOWN)>	// Schematic Col 5
			, <&pro_micro 15 (GPIO_ACTIVE_HIGH | GPIO_PULL_DOWN)>	// Schematic Col 4
			, <&pro_micro 18 (GPIO_ACTIVE_HIGH | GPIO_PULL_DOWN)>	// Schematic Col 3
			, <&pro_micro 19 (GPIO_ACTIVE_HIGH | GPIO_PULL_DOWN)>	// Schematic Col 2
			, <&pro_micro 20 (GPIO_ACTIVE_HIGH | GPIO_PULL_DOWN)>	// Schematic Col 1
			, <&pro_micro 21 (GPIO_ACTIVE_HIGH | GPIO_PULL_DOWN)>	// Schematic Col 0
			;
}