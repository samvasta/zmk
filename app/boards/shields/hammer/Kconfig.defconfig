## app/boards/shields/hammer/Kconfig.defconfig
```kconfig
if SHIELD_HAMMER_LEFT

config ZMK_KEYBOARD_NAME
    default "hammer3"

config ZMK_SPLIT_ROLE_CENTRAL
    default y

endif

if SHIELD_HAMMER_LEFT || SHIELD_HAMMER_RIGHT

config ZMK_SPLIT
    default y

endif
```

## app/boards/shields/hammer/Kconfig.shield
```kconfig
config SHIELD_HAMMER_LEFT
	def_bool $(shields_list_contains,hammer_left)

config SHIELD_HAMMER_RIGHT
	def_bool $(shields_list_contains,hammer_right)
```

## app/boards/shields/hammer2/Kconfig.defconfig
```kconfig
if SHIELD_HAMMER2_LEFT

config ZMK_KEYBOARD_NAME
    default "keeb"

config ZMK_SPLIT_ROLE_CENTRAL
    default y

endif

if SHIELD_HAMMER2_LEFT || SHIELD_HAMMER2_RIGHT

config ZMK_SPLIT
    default y

endif
```

## app/boards/shields/hammer2/Kconfig.shield
```kconfig
config SHIELD_HAMMER2_LEFT
    def_bool $(shields_list_contains,hammer2_left)

config SHIELD_HAMMER2_RIGHT
    def_bool $(shields_list_contains,hammer2_right)
```

## app/boards/shields/samvasta/input/Kconfig.shield
```kconfig
config SHIELD_INPUT_LEFT
    def_bool $(shields_list_contains,input2_left)

config SHIELD_INPUT_RIGHT
    def_bool $(shields_list_contains,input_right)
```

## app/boards/shields/wanderer/Kconfig.defconfig
```kconfig
if SHIELD_WANDERER

config ZMK_KEYBOARD_NAME
    default "keeb"

config ZMK_SPLIT_ROLE_CENTRAL
    default y

config ZMK_SPLIT
    default n

endif
```

## app/boards/shields/wing_it/Kconfig.defconfig
```kconfig
# Copyright (c) 2020 The ZMK Contributors
# SPDX-License-Identifier: MIT

if SHIELD_WING_IT_LEFT

config ZMK_KEYBOARD_NAME
	default "wing_it"

config ZMK_SPLIT_ROLE_CENTRAL
	default y

endif

if SHIELD_WING_IT_LEFT || SHIELD_WING_IT_RIGHT

config ZMK_SPLIT
	default y

endif
```

## app/boards/shields/wing_it/Kconfig.shield
```kconfig
config SHIELD_WING_IT_LEFT
	def_bool $(shields_list_contains,wing_it_left)

config SHIELD_WING_IT_RIGHT
	def_bool $(shields_list_contains,wing_it_right)
```

## app/dts/bindings/behaviors/zmk,bahavior-os-key-press.yaml
```yaml
# Copyright (c) 2022 The ZMK Contributors
# SPDX-License-Identifier: MIT

description: OS Key behavior

compatible: "zmk,behavior-os-key-tap"

include: zero_param.yaml

# properties:
#   "#winlin_binding-cells":
#     type: int
#     required: true
#     const: 0
#   "#osx_binding-cells":
#     type: int
#     required: true
#     const: 0
```

## app/dts/bindings/behaviors/zmk,bahavior-os-key.yaml
```yaml
# Copyright (c) 2022 The ZMK Contributors
# SPDX-License-Identifier: MIT

description: OS Key behavior

compatible: "zmk,behavior-os-key"

include: two_param.yaml

properties:
  bindings:
    type: phandles
    required: true
```

## app/dts/bindings/behaviors/zmk,bahavior-os-mode.yaml
```yaml
# Copyright (c) 2022 The ZMK Contributors
# SPDX-License-Identifier: MIT

description: OS Mode behavior

compatible: "zmk,behavior-os-mode"

include: two_param.yaml
```

## app/dts/bindings/behaviors/zmk,behavior-meta-mod-set.yaml
```yaml
# Copyright (c) 2022 The ZMK Contributors
# SPDX-License-Identifier: MIT

description: Meta mod behavior

compatible: "zmk,behavior-meta-mod-set"

include: one_param.yaml
```

## app/dts/bindings/behaviors/zmk,behavior-meta-mod.yaml
```yaml
# Copyright (c) 2022 The ZMK Contributors
# SPDX-License-Identifier: MIT

description: Meta mod behavior

compatible: "zmk,behavior-meta-mod"

include: two_param.yaml

properties:
  bindings:
    type: phandles
    required: true
```

## app/dts/bindings/behaviors/zmk,behavior-multi-function-set.yaml
```yaml
# Copyright (c) 2020 The ZMK Contributors
# SPDX-License-Identifier: MIT

description: Multi Function behavior

compatible: "zmk,behavior-multi-function-set"

include: two_param.yaml
```

## app/dts/bindings/behaviors/zmk,behavior-multi-function.yaml
```yaml
# Copyright (c) 2020 The ZMK Contributors
# SPDX-License-Identifier: MIT

description: Multi Function behavior

compatible: "zmk,behavior-multi-function"

include: zero_param.yaml

properties:
  bindings:
    type: phandle-array
    required: true
```
